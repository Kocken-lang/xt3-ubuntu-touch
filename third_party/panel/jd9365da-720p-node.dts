			qcom,mdss_dsi_jd9365da_720p_video {
				qcom,mdss-dsi-panel-name = "jd9365da 720p video mode dsi panel";
				qcom,mdss-dsi-panel-controller = <0x21c>;
				qcom,mdss-dsi-panel-type = "dsi_video_mode";
				qcom,mdss-dsi-panel-destination = "display_1";
				qcom,mdss-dsi-panel-framerate = <0x3c>;
				qcom,mdss-dsi-virtual-channel-id = <0x00>;
				qcom,mdss-dsi-stream = <0x00>;
				qcom,mdss-dsi-panel-width = <0x2d0>;
				qcom,mdss-dsi-panel-height = <0x500>;
				qcom,mdss-dsi-h-front-porch = <0x1b>;
				qcom,mdss-dsi-h-back-porch = <0x17>;
				qcom,mdss-dsi-h-pulse-width = <0x12>;
				qcom,mdss-dsi-h-sync-skew = <0x00>;
				qcom,mdss-dsi-v-front-porch = <0x0d>;
				qcom,mdss-dsi-v-back-porch = <0x0b>;
				qcom,mdss-dsi-v-pulse-width = <0x07>;
				qcom,mdss-dsi-h-left-border = <0x00>;
				qcom,mdss-dsi-h-right-border = <0x00>;
				qcom,mdss-dsi-v-top-border = <0x00>;
				qcom,mdss-dsi-v-bottom-border = <0x00>;
				qcom,mdss-dsi-bpp = <0x18>;
				qcom,mdss-dsi-color-order = "rgb_swap_rgb";
				qcom,mdss-dsi-underflow-color = <0xff>;
				qcom,mdss-dsi-border-color = <0x00>;
				qcom,mdss-dsi-on-command = [39 01 00 00 00 00 02 e0 00 39 01 00 00 00 00 02 e1 93 39 01 00 00 00 00 02 e2 65 39 01 00 00 00 00 02 e3 f8 39 01 00 00 00 00 02 80 03 39 01 00 00 00 00 02 e0 01 39 01 00 00 00 00 02 00 00 39 01 00 00 00 00 02 01 d6 39 01 00 00 00 00 02 03 00 39 01 00 00 00 00 02 04 e7 39 01 00 00 00 00 02 0c 66 39 01 00 00 00 00 02 17 00 39 01 00 00 00 00 02 18 ef 39 01 00 00 00 00 02 19 01 39 01 00 00 00 00 02 1a 00 39 01 00 00 00 00 02 1b ef 39 01 00 00 00 00 02 1c 01 39 01 00 00 00 00 02 1f 6b 39 01 00 00 00 00 02 20 24 39 01 00 00 00 00 02 21 24 39 01 00 00 00 00 02 22 4e 39 01 00 00 00 00 02 24 fe 39 01 00 00 00 00 02 37 09 39 01 00 00 00 00 02 38 04 39 01 00 00 00 00 02 39 08 39 01 00 00 00 00 02 3a 12 39 01 00 00 00 00 02 3c 78 39 01 00 00 00 00 02 3d ff 39 01 00 00 00 00 02 3e ff 39 01 00 00 00 00 02 3f 7f 39 01 00 00 00 00 02 40 04 39 01 00 00 00 00 02 41 a0 39 01 00 00 00 00 02 43 0f 39 01 00 00 00 00 02 44 17 39 01 00 00 00 00 02 45 46 39 01 00 00 00 00 02 55 02 39 01 00 00 00 00 02 56 01 39 01 00 00 00 00 02 57 49 39 01 00 00 00 00 02 58 00 39 01 00 00 00 00 02 59 20 39 01 00 00 00 00 02 5a 70 39 01 00 00 00 00 02 5b 0d 39 01 00 00 00 00 02 5d 57 39 01 00 00 00 00 02 5e 4a 39 01 00 00 00 00 02 5f 3f 39 01 00 00 00 00 02 60 36 39 01 00 00 00 00 02 61 36 39 01 00 00 00 00 02 62 28 39 01 00 00 00 00 02 63 2f 39 01 00 00 00 00 02 64 1b 39 01 00 00 00 00 02 65 34 39 01 00 00 00 00 02 66 33 39 01 00 00 00 00 02 67 32 39 01 00 00 00 00 02 68 4f 39 01 00 00 00 00 02 69 3c 39 01 00 00 00 00 02 6a 43 39 01 00 00 00 00 02 6b 35 39 01 00 00 00 00 02 6c 31 39 01 00 00 00 00 02 6d 24 39 01 00 00 00 00 02 6e 15 39 01 00 00 00 00 02 6f 09 39 01 00 00 00 00 02 70 57 39 01 00 00 00 00 02 71 4a 39 01 00 00 00 00 02 72 3f 39 01 00 00 00 00 02 73 36 39 01 00 00 00 00 02 74 36 39 01 00 00 00 00 02 75 28 39 01 00 00 00 00 02 76 2f 39 01 00 00 00 00 02 77 1b 39 01 00 00 00 00 02 78 34 39 01 00 00 00 00 02 79 33 39 01 00 00 00 00 02 7a 32 39 01 00 00 00 00 02 7b 4f 39 01 00 00 00 00 02 7c 3c 39 01 00 00 00 00 02 7d 43 39 01 00 00 00 00 02 7e 35 39 01 00 00 00 00 02 7f 31 39 01 00 00 00 00 02 80 24 39 01 00 00 00 00 02 81 15 39 01 00 00 00 00 02 82 09 39 01 00 00 00 00 02 e0 02 39 01 00 00 00 00 02 00 5e 39 01 00 00 00 00 02 01 5f 39 01 00 00 00 00 02 02 57 39 01 00 00 00 00 02 03 58 39 01 00 00 00 00 02 04 48 39 01 00 00 00 00 02 05 4a 39 01 00 00 00 00 02 06 44 39 01 00 00 00 00 02 07 46 39 01 00 00 00 00 02 08 40 39 01 00 00 00 00 02 09 5f 39 01 00 00 00 00 02 0a 42 39 01 00 00 00 00 02 0b 5f 39 01 00 00 00 00 02 0c 5f 39 01 00 00 00 00 02 0d 5f 39 01 00 00 00 00 02 0e 5f 39 01 00 00 00 00 02 0f 5f 39 01 00 00 00 00 02 10 5f 39 01 00 00 00 00 02 11 5f 39 01 00 00 00 00 02 12 5f 39 01 00 00 00 00 02 13 5f 39 01 00 00 00 00 02 14 5f 39 01 00 00 00 00 02 15 5f 39 01 00 00 00 00 02 16 5e 39 01 00 00 00 00 02 17 5f 39 01 00 00 00 00 02 18 57 39 01 00 00 00 00 02 19 58 39 01 00 00 00 00 02 1a 49 39 01 00 00 00 00 02 1b 4b 39 01 00 00 00 00 02 1c 45 39 01 00 00 00 00 02 1d 47 39 01 00 00 00 00 02 1e 41 39 01 00 00 00 00 02 1f 5f 39 01 00 00 00 00 02 20 43 39 01 00 00 00 00 02 21 5f 39 01 00 00 00 00 02 22 5f 39 01 00 00 00 00 02 23 5f 39 01 00 00 00 00 02 24 5f 39 01 00 00 00 00 02 25 5f 39 01 00 00 00 00 02 26 5f 39 01 00 00 00 00 02 27 5f 39 01 00 00 00 00 02 28 5f 39 01 00 00 00 00 02 29 5f 39 01 00 00 00 00 02 2a 5f 39 01 00 00 00 00 02 2b 5f 39 01 00 00 00 00 02 2c 1f 39 01 00 00 00 00 02 2d 1e 39 01 00 00 00 00 02 2e 17 39 01 00 00 00 00 02 2f 18 39 01 00 00 00 00 02 30 07 39 01 00 00 00 00 02 31 05 39 01 00 00 00 00 02 32 0b 39 01 00 00 00 00 02 33 09 39 01 00 00 00 00 02 34 03 39 01 00 00 00 00 02 35 1f 39 01 00 00 00 00 02 36 01 39 01 00 00 00 00 02 37 1f 39 01 00 00 00 00 02 38 1f 39 01 00 00 00 00 02 39 1f 39 01 00 00 00 00 02 3a 1f 39 01 00 00 00 00 02 3b 1f 39 01 00 00 00 00 02 3c 1f 39 01 00 00 00 00 02 3d 1f 39 01 00 00 00 00 02 3e 1f 39 01 00 00 00 00 02 3f 1f 39 01 00 00 00 00 02 40 1f 39 01 00 00 00 00 02 41 1f 39 01 00 00 00 00 02 42 1f 39 01 00 00 00 00 02 43 1e 39 01 00 00 00 00 02 44 17 39 01 00 00 00 00 02 45 18 39 01 00 00 00 00 02 46 06 39 01 00 00 00 00 02 47 04 39 01 00 00 00 00 02 48 0a 39 01 00 00 00 00 02 49 08 39 01 00 00 00 00 02 4a 02 39 01 00 00 00 00 02 4b 1f 39 01 00 00 00 00 02 4c 00 39 01 00 00 00 00 02 4d 1f 39 01 00 00 00 00 02 4e 1f 39 01 00 00 00 00 02 4f 1f 39 01 00 00 00 00 02 50 1f 39 01 00 00 00 00 02 51 1f 39 01 00 00 00 00 02 52 1f 39 01 00 00 00 00 02 53 1f 39 01 00 00 00 00 02 54 1f 39 01 00 00 00 00 02 55 1f 39 01 00 00 00 00 02 56 1f 39 01 00 00 00 00 02 57 1f 39 01 00 00 00 00 02 58 40 39 01 00 00 00 00 02 59 00 39 01 00 00 00 00 02 5a 00 39 01 00 00 00 00 02 5b 30 39 01 00 00 00 00 02 5c 0d 39 01 00 00 00 00 02 5d 30 39 01 00 00 00 00 02 5e 01 39 01 00 00 00 00 02 5f 02 39 01 00 00 00 00 02 60 20 39 01 00 00 00 00 02 61 01 39 01 00 00 00 00 02 62 02 39 01 00 00 00 00 02 63 03 39 01 00 00 00 00 02 64 5e 39 01 00 00 00 00 02 65 35 39 01 00 00 00 00 02 66 16 39 01 00 00 00 00 02 67 73 39 01 00 00 00 00 02 68 11 39 01 00 00 00 00 02 69 03 39 01 00 00 00 00 02 6a 5e 39 01 00 00 00 00 02 6b 08 39 01 00 00 00 00 02 6c 00 39 01 00 00 00 00 02 6d 00 39 01 00 00 00 00 02 6e 00 39 01 00 00 00 00 02 6f 88 39 01 00 00 00 00 02 70 00 39 01 00 00 00 00 02 71 00 39 01 00 00 00 00 02 72 06 39 01 00 00 00 00 02 73 7b 39 01 00 00 00 00 02 74 00 39 01 00 00 00 00 02 75 bc 39 01 00 00 00 00 02 76 00 39 01 00 00 00 00 02 77 0d 39 01 00 00 00 00 02 78 28 39 01 00 00 00 00 02 79 00 39 01 00 00 00 00 02 7a 00 39 01 00 00 00 00 02 7b 00 39 01 00 00 00 00 02 7c 00 39 01 00 00 00 00 02 7d 03 39 01 00 00 00 00 02 7e 7b 39 01 00 00 00 00 02 e0 00 39 01 00 00 00 00 02 e6 02 39 01 00 00 00 00 02 e7 02 39 01 00 00 00 00 02 e0 00 39 01 00 00 00 00 02 00 0e 39 01 00 00 00 00 02 02 b3 39 01 00 00 00 00 02 09 60 39 01 00 00 00 00 02 e0 00 05 01 00 00 78 00 02 11 00 05 01 00 00 50 00 02 29 00 05 01 00 00 32 00 02 35 00];
				qcom,mdss-dsi-off-command = [05 01 00 00 32 00 02 28 00 05 01 00 00 78 00 02 10 00];
				qcom,mdss-dsi-on-command-state = "dsi_lp_mode";
				qcom,mdss-dsi-off-command-state = "dsi_hs_mode";
				qcom,mdss-dsi-h-sync-pulse = <0x01>;
				qcom,mdss-dsi-traffic-mode = "burst_mode";
				qcom,mdss-dsi-lane-map = "lane_map_0123";
				qcom,mdss-dsi-bllp-eof-power-mode;
				qcom,mdss-dsi-bllp-power-mode;
				qcom,mdss-dsi-lane-0-state;
				qcom,mdss-dsi-lane-1-state;
				qcom,mdss-dsi-lane-2-state;
				qcom,mdss-dsi-lane-3-state;
				qcom,mdss-dsi-panel-timings-phy = <0x861e1400 0x42461820 0x16030400>;
				qcom,mdss-dsi-t-clk-post = <0x1e>;
				qcom,mdss-dsi-t-clk-pre = <0x2a>;
				qcom,mdss-dsi-dma-trigger = "trigger_sw";
				qcom,mdss-dsi-mdp-trigger = "none";
				qcom,mdss-dsi-bl-pmic-control-type = "bl_ctrl_wled";
				qcom,mdss-dsi-reset-sequence = <0x01 0x14 0x00 0x01 0x01 0x14>;
				qcom,mdss-dsi-reset-delay = <0x78>;
				qcom,esd-check-enabled;
				qcom,mdss-dsi-panel-status-command = <0x14010001 0x500010a>;
				qcom,mdss-dsi-panel-status-command-state = "dsi_lp_mode";
				qcom,mdss-dsi-panel-status-check-mode = "reg_read";
				qcom,mdss-dsi-panel-status-value = <0x9c>;
				qcom,mdss-pan-physical-width-dimension = <0x3e>;
				qcom,mdss-pan-physical-height-dimension = <0x6e>;
				qcom,mdss-dsi-panel-timings-phy-v2 = <0x1e1b0406 0x20204a0 0x1e1b0406 0x20204a0 0x1e1b0406 0x20204a0 0x1e1b0406 0x20204a0 0x1e1b0406 0x20204a0>;
				phandle = <0x3b3>;
			};

			qcom,mdss_dsi_nt35521sh_720p_video {
				qcom,mdss-dsi-panel-name = "nt35521sh 720p video mode dsi panel";
				qcom,mdss-dsi-panel-controller = <0x21c>;
				qcom,mdss-dsi-panel-type = "dsi_video_mode";
				qcom,mdss-dsi-panel-destination = "display_1";
				qcom,mdss-dsi-panel-framerate = <0x3c>;
				qcom,mdss-dsi-virtual-channel-id = <0x00>;
				qcom,mdss-dsi-stream = <0x00>;
				qcom,mdss-dsi-panel-width = <0x2d0>;
				qcom,mdss-dsi-panel-height = <0x500>;
				qcom,mdss-dsi-h-front-porch = <0x4e>;
				qcom,mdss-dsi-h-back-porch = <0x64>;
				qcom,mdss-dsi-h-pulse-width = <0x10>;
				qcom,mdss-dsi-h-sync-skew = <0x00>;
				qcom,mdss-dsi-v-back-porch = <0x06>;
				qcom,mdss-dsi-v-front-porch = <0x0a>;
				qcom,mdss-dsi-v-pulse-width = <0x04>;
				qcom,mdss-dsi-h-left-border = <0x00>;
				qcom,mdss-dsi-h-right-border = <0x00>;
				qcom,mdss-dsi-v-top-border = <0x00>;
				qcom,mdss-dsi-v-bottom-border = <0x00>;
				qcom,mdss-dsi-bpp = <0x18>;
				qcom,mdss-dsi-color-order = "rgb_swap_rgb";
				qcom,mdss-dsi-underflow-color = <0xff>;
				qcom,mdss-dsi-border-color = <0x00>;
				qcom,mdss-dsi-on-command = <0x39010000 0x5ff 0xaa552501 0x39010000 0x2fc 0x8390100 0x02 0xfc003901 0x00 0x26f2139 0x1000000 0x2f701 0x39010000 0x26f 0x21390100 0x02 0xf7013901 0x00 0x26f2139 0x1000000 0x2f700 0x39010000 0x26f 0x1a390100 0x02 0xf7053901 0x00 0x5ffaa55 0x25003901 0x00 0x6f055aa 0x52080039 0x1000000 0x3b164 0x21390100 0x02 0xb6083901 0x00 0x4b80102 0x8390100 0x03 0xbb444439 0x1000000 0x3bc00 0x390100 0x06 0xbd026810 0x10003901 0x00 0x2c88039 0x1000000 0x6f055 0xaa520801 0x39010000 0x3b3 0x32323901 0x00 0x3b41919 0x39010000 0x3b5 0x5053901 0x00 0x3b92424 0x39010000 0x3ba 0x25253901 0x00 0x3bc7801 0x39010000 0x3bd 0x78013901 0x00 0x2be6839 0x1000000 0x2c00c 0x39010000 0x2ca 0x390100 0x06 0xf055aa52 0x8023901 0x00 0x2ee0139 0x1000000 0x11b000 0x1001600 0x3b005300 0x65008900 0xad00e939 0x1000000 0x11b101 0x17015a01 0x9601ed02 0x3a023c02 0x7f02c739 0x1000000 0x11b202 0xf4032b03 0x57038d03 0xac03ca03 0xe503f539 0x1000000 0x5b303 0xfd03ff39 0x1000000 0x6f055 0xaa520803 0x39010000 0x3b0 0x3901 0x00 0x3b10000 0x39010000 0x6b2 0x500b100 0xb0390100 0x06 0xb60500b0 0xb03901 0x00 0x6ba5300 0xb0000039 0x1000000 0x6bb53 0xb00000 0x39010000 0x2c4 0x60390100 0x02 0xc5c03901 0x00 0x6f055aa 0x52080539 0x1000000 0x3b017 0x6390100 0x03 0xb1170639 0x1000000 0x3b217 0x6390100 0x03 0xb4170639 0x1000000 0x3b517 0x6390100 0x02 0xb8003901 0x00 0x2b90039 0x1000000 0x2ba00 0x39010000 0x2bc 0x2390100 0x06 0xbd030101 0x33901 0x00 0x2c00739 0x1000000 0x2c4a1 0x39010000 0x3c8 0x3203901 0x00 0x3c90121 0x39010000 0x6d1 0x50d07 0x390100 0x06 0xd200050d 0x3901 0x00 0x2e50639 0x1000000 0x2e606 0x39010000 0x2e7 0x6390100 0x02 0xe9063901 0x00 0x2ea0639 0x1000000 0x2ed30 0x39010000 0x6f0 0x55aa5208 0x6390100 0x03 0xb0001039 0x1000000 0x3b112 0x16390100 0x03 0xb2183439 0x1000000 0x3b334 0x34390100 0x03 0xb4313439 0x1000000 0x3b534 0x34390100 0x03 0xb6313439 0x1000000 0x3b734 0x34390100 0x03 0xb8342d39 0x1000000 0x3b92e 0x8390100 0x03 0xba092e39 0x1000000 0x3bb2d 0x34390100 0x03 0xbc343439 0x1000000 0x3bd31 0x34390100 0x03 0xbe343439 0x1000000 0x3bf34 0x34390100 0x03 0xc0313439 0x1000000 0x3c134 0x19390100 0x03 0xc2171339 0x1000000 0x3c311 0x1390100 0x03 0xe5313439 0x1000000 0x3c409 0x19390100 0x03 0xc5171339 0x1000000 0x3c611 0x34390100 0x03 0xc7343439 0x1000000 0x3c831 0x34390100 0x03 0xc9343439 0x1000000 0x3ca31 0x29390100 0x03 0xcb2a3339 0x1000000 0x3cc2d 0x2e390100 0x03 0xcd2d0139 0x1000000 0x3ce00 0x2d390100 0x03 0xcf2e2d39 0x1000000 0x3d034 0x2a390100 0x03 0xd1313439 0x1000000 0x3d234 0x34390100 0x03 0xd3343439 0x1000000 0x3d431 0x34390100 0x03 0xd5341039 0x1000000 0x3d612 0x16390100 0x03 0xd7180839 0x1000000 0x6d800 0x00 0x39010000 0x6d9 0x00 0x390100 0x02 0xe7000501 0x7800 0x2110005 0x1000032 0x22900>;
				qcom,mdss-dsi-off-command = [05 01 00 00 32 00 02 28 00 05 01 00 00 78 00 02 10 00];
				qcom,mdss-dsi-on-command-state = "dsi_lp_mode";
				qcom,mdss-dsi-off-command-state = "dsi_hs_mode";
				qcom,mdss-dsi-h-sync-pulse = <0x01>;
				qcom,mdss-dsi-traffic-mode = "burst_mode";
				qcom,mdss-dsi-lane-map = "lane_map_0123";
				qcom,mdss-dsi-bllp-eof-power-mode;
				qcom,mdss-dsi-bllp-power-mode;
				qcom,mdss-dsi-lane-0-state;
				qcom,mdss-dsi-lane-1-state;
				qcom,mdss-dsi-lane-2-state;
				qcom,mdss-dsi-lane-3-state;
				qcom,mdss-dsi-panel-timings = <0x8b1e1400 0x44481822 0x19030400>;
				qcom,mdss-dsi-t-clk-post = <0x1f>;
				qcom,mdss-dsi-t-clk-pre = <0x2d>;
				qcom,mdss-dsi-bl-min-level = <0x01>;
				qcom,mdss-dsi-bl-max-level = <0xff>;
				qcom,mdss-dsi-dma-trigger = "trigger_sw";
				qcom,mdss-dsi-mdp-trigger = "none";
				qcom,mdss-dsi-bl-pmic-control-type = "bl_ctrl_wled";
				qcom,mdss-dsi-reset-sequence = <0x01 0x14 0x00 0x01 0x01 0x14>;
				qcom,esd-check-enabled;
				qcom,mdss-dsi-panel-status-command = <0x14010001 0x500010a>;
				qcom,mdss-dsi-panel-status-command-state = "dsi_lp_mode";
				qcom,mdss-dsi-panel-status-check-mode = "reg_read";
				qcom,mdss-dsi-panel-status-value = <0x9c>;
				qcom,mdss-pan-physical-width-dimension = <0x3e>;
				qcom,mdss-pan-physical-height-dimension = <0x6e>;
				qcom,mdss-dsi-panel-timings-phy-v2 = <0x1e1b0406 0x20204a0 0x1e1b0406 0x20204a0 0x1e1b0406 0x20204a0 0x1e1b0406 0x20204a0 0x1e1b0406 0x20204a0>;
				phandle = <0x3b4>;
			};

